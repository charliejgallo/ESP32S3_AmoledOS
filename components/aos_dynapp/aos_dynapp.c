/*
 * AmoledOS - Dynamic loading of applications.
 *
 * Apps are loaded **on demand**: at startup each .so is only opened far enough
 * to read its descriptor (name, icon, colour) and closed again. The code
 * enters RAM only when the user opens the app, and leaves when they close it.
 *
 * This is not an optimisation, it is the only thing that fits. The apps' .text
 * has to live in executable internal RAM, of which there is about 83 KB; the
 * six apps together add up to 134 KB. One at a time, on the other hand, is
 * plenty: the largest is 43 KB. Measured on the board.
 */
#include "aos_dynapp.h"
#include "aos_app.h"
#include "aos_ui.h"
#include "aos_hal.h"

#include "esp_log.h"
#include "esp_heap_caps.h"
#include "esp_dlfcn.h"
#include "private/elf_symbol.h"

#include <dirent.h>
#include <string.h>
#include <sys/stat.h>
#include <time.h>
#include <stdio.h>

static const char *TAG = "aos_dynapp";

/* How many microSD apps fit.
 *
 * It was at 16 and there were 17 .so files: the seventeenth was discarded by
 * returning false, WITHOUT A SINGLE LOG LINE, and from the other side it
 * looked like an app that simply did not show up in the menu. It is exactly
 * the same bug that had already happened in the simulator with MAX_SIM_APPS
 * (12 slots, 14 apps), so now it is 32 -like over there- and the limit also
 * SAYS SO when it fills up. Each slot is ~230 bytes of .bss, so the 32 cost
 * 7 KB. */
#define MAX_DYNAPPS     32

/* The descriptor's strings point into the .so's rodata, which disappears when
 * it is closed: a copy of our own has to be kept. */
typedef struct {
    char  file[64];
    char  id[40];
    char  name[40];
    char  icon[16];

    aos_app_t loaded;       /* real callbacks, valid when handle != NULL */
    void     *handle;
    bool      pending_close;
    bool      in_use;
} dynapp_t;

AOS_BSS_PSRAM static dynapp_t s_apps[MAX_DYNAPPS];
static int      s_count;

/* Table generated by tools/gen_symbols.py from the firmware's libraries. If it
 * has not been generated yet, it stays empty and the apps can only use the
 * libc and ESP-IDF symbols elf_loader already brings. */
extern const struct esp_elfsym aos_symbol_table[];

/* --------------------------------------------------------------------------
 * Where the loader gets its memory
 *
 * The component's esp_elf_malloc() asks for MALLOC_CAP_8BIT for everything
 * that is not code, and that lands in internal RAM. The problem is that
 * dlopen() reads the WHOLE file into memory before allocating the .text, so
 * the .so competes with itself for the single large internal block there is:
 *
 *     g2043:  57 KB of file + 43 KB of .text  against a 69 KB block
 *
 * The data does not need to be inside: it goes to PSRAM and internal RAM is
 * left whole for the code, which does have to be executable. It is intercepted
 * with -Wl,--wrap so as not to have to fork the component.
 * -------------------------------------------------------------------------- */
/* -----------------------------------------------------------------------------
 * Contiguous reservation for the apps' code
 *
 * Measured on the board: after opening and closing several apps the executable
 * heap was left with 54 KB free spread over 34 holes, the largest 32 KB. A
 * 45 KB app does not fit even though the total is there. The general heap
 * fragments because it mixes allocations of every size and lifetime.
 *
 * The way out is to set ONE large block aside at startup -when there is no
 * fragmentation yet- and serve the apps' .text from it. Since one app is open
 * at a time, that block fills and empties whole: it cannot be pulverised.
 *
 * The size has to be enough for the largest app without starving the rest.
 *
 * 2026-09-04: RAISING IT TO 80 KB WAS TRIED AND REVERTED.
 *
 * The reason for raising it turned out to be FALSE: it was believed that g2043
 * no longer fitted, comparing xtensa-esp-elf-size's "text" column (58,936 B)
 * against the 48 KB. But that column adds up the whole read-only segment
 * -.rodata, .dynsym, .dynstr, .rela, .hash-, and the loader allocates as
 * executable ONLY the .text section, which is 46,282 B. It fits, and the
 * fallback warning added in __wrap_esp_elf_malloc() did not fire once while
 * loading the 19 apps. To measure this the tool is
 * `xtensa-esp-elf-objdump -h`, not `size`.
 *
 * What was learned is that raising it is NOT free even when there is internal
 * RAM to spare, because it comes out of the same pool WiFi eats from. And that
 * free executable memory has to be looked at IN STEADY STATE, not eight
 * seconds after booting:
 *
 *     reservation 48 KB -> just booted 96.4 KB free, STEADY STATE 41.3 KB
 *     reservation 80 KB -> just booted 62.8 KB free, STEADY STATE  9.3 KB
 *
 * The extra 32 KB cost exactly 32: the mechanism works. But leaving free
 * executable memory at 9 KB is walking straight into the failure mode that
 * gives no warning.
 *
 * Where there IS room: the .so files are compiled without any -O (see the note
 * in HANDOFF-APPS.md section 5.5). With -Os g2043 drops to 28 KB, so the
 * reservation would go from being 94% full to 57% without touching a line of
 * the apps.
 *
 * If something does not fit in the reservation it falls back to the general
 * heap, which is still there, but NOW IT SAYS SO: a silent fallback is what
 * let the g2043 problem go unnoticed for months.
 * -------------------------------------------------------------------------- */

#define POOL_BYTES      (48 * 1024)
#define POOL_MAX_BLOCK  8               /* simultaneous modules, plenty */

static uint8_t *s_pool;
static struct {
    uint32_t off;
    uint32_t len;
    bool     used;
} s_pool_blk[POOL_MAX_BLOCK];

static void pool_init(void)
{
    if (s_pool) {
        return;
    }
    s_pool = heap_caps_malloc(POOL_BYTES, MALLOC_CAP_EXEC);
    if (!s_pool) {
        ESP_LOGW(TAG, "no contiguous reservation: the general heap is used");
        return;
    }
    ESP_LOGI(TAG, "code reservation: %u KB contiguous at %p",
             (unsigned)(POOL_BYTES / 1024), s_pool);
}

/* First hole that fits. With few large blocks nothing more is needed. */
static void *pool_alloc(uint32_t n)
{
    if (!s_pool || n > POOL_BYTES) {
        return NULL;
    }
    n = (n + 15u) & ~15u;               /* aligned to 16 */

    uint32_t cursor = 0;
    for (;;) {
        uint32_t fin = POOL_BYTES;
        int      choque = -1;

        /* how far the hole starting at 'cursor' reaches */
        for (int i = 0; i < POOL_MAX_BLOCK; i++) {
            if (s_pool_blk[i].used && s_pool_blk[i].off >= cursor &&
                s_pool_blk[i].off < fin) {
                fin = s_pool_blk[i].off;
                choque = i;
            }
        }
        if (fin - cursor >= n) {
            for (int i = 0; i < POOL_MAX_BLOCK; i++) {
                if (!s_pool_blk[i].used) {
                    s_pool_blk[i].off  = cursor;
                    s_pool_blk[i].len  = n;
                    s_pool_blk[i].used = true;
                    return s_pool + cursor;
                }
            }
            return NULL;                /* no free descriptor */
        }
        if (choque < 0) {
            return NULL;                /* no room left */
        }
        cursor = s_pool_blk[choque].off + s_pool_blk[choque].len;
    }
}

static bool pool_free(void *p)
{
    if (!s_pool || (uint8_t *)p < s_pool || (uint8_t *)p >= s_pool + POOL_BYTES) {
        return false;                   /* not ours */
    }
    uint32_t off = (uint32_t)((uint8_t *)p - s_pool);
    for (int i = 0; i < POOL_MAX_BLOCK; i++) {
        if (s_pool_blk[i].used && s_pool_blk[i].off == off) {
            s_pool_blk[i].used = false;
            return true;
        }
    }
    ESP_LOGE(TAG, "free of %p, which is not in the reservation", p);
    return true;                        /* ours all the same: it does not go to the heap */
}


/* State of the code reservation. Since it exists, the general executable heap
 * no longer reflects what the apps have available: the reservation shows as
 * occupied even when it is empty inside. Without this there is no way to look
 * at it. */
void aos_dynapp_pool_info(uint32_t *libre, uint32_t *mayor, int *usados)
{
    uint32_t ocupado = 0, mejor = 0, cursor = 0;
    int n = 0;

    if (!s_pool) {
        if (libre)  *libre  = 0;
        if (mayor)  *mayor  = 0;
        if (usados) *usados = -1;      /* -1 = there is no reservation */
        return;
    }

    for (int i = 0; i < POOL_MAX_BLOCK; i++) {
        if (s_pool_blk[i].used) {
            ocupado += s_pool_blk[i].len;
            n++;
        }
    }

    /* the largest contiguous hole, walking the reservation in order */
    for (;;) {
        uint32_t fin = POOL_BYTES;
        int choque = -1;
        for (int i = 0; i < POOL_MAX_BLOCK; i++) {
            if (s_pool_blk[i].used && s_pool_blk[i].off >= cursor &&
                s_pool_blk[i].off < fin) {
                fin = s_pool_blk[i].off;
                choque = i;
            }
        }
        if (fin - cursor > mejor) {
            mejor = fin - cursor;
        }
        if (choque < 0) {
            break;
        }
        cursor = s_pool_blk[choque].off + s_pool_blk[choque].len;
    }

    if (libre)  *libre  = POOL_BYTES - ocupado;
    if (mayor)  *mayor  = mejor;
    if (usados) *usados = n;
}

void *__wrap_esp_elf_malloc(uint32_t n, bool exec)
{
    if (exec) {
        void *p = pool_alloc(n);
        if (p) {
            return p;
        }
        /* Falling back to the general heap is not free: it is going back to
         * the scenario the reservation came to solve, and there a large app
         * fits or does not depending on how the fragmentation turned out. Let
         * it show in the log. */
        ESP_LOGW(TAG, "%u B of code did NOT fit in the reservation: going to the "
                      "general heap (free %u B, largest block %u B). If this "
                      "comes up often, the reservation is too small.",
                 (unsigned)n,
                 (unsigned)heap_caps_get_free_size(MALLOC_CAP_EXEC),
                 (unsigned)heap_caps_get_largest_free_block(MALLOC_CAP_EXEC));
        return heap_caps_malloc(n, MALLOC_CAP_EXEC);
    }
    void *p = heap_caps_malloc(n, MALLOC_CAP_SPIRAM | MALLOC_CAP_8BIT);
    return p ? p : heap_caps_malloc(n, MALLOC_CAP_8BIT);
}

/* The free has to be intercepted TOO: otherwise the loader would hand free() a
 * pointer that never came out of the heap. */
void __wrap_esp_elf_free(void *ptr)
{
    if (!ptr || pool_free(ptr)) {
        return;
    }
    heap_caps_free(ptr);
}


static uintptr_t resolver(const char *name)
{
    for (const struct esp_elfsym *sym = aos_symbol_table; sym->name; sym++) {
        if (strcmp(sym->name, name) == 0) {
            return (uintptr_t)sym->sym;
        }
    }
    return elf_find_sym_default(name);
}

static dynapp_t *find_by_id(const char *id)
{
    for (int i = 0; i < s_count; i++) {
        if (s_apps[i].in_use && strcmp(s_apps[i].id, id) == 0) {
            return &s_apps[i];
        }
    }
    return NULL;
}

/* --------------------------------------------------------------------------
 * Opening and closing the .so
 * -------------------------------------------------------------------------- */

/* Opens the module and returns the aos_app_t its init() builds. */
static bool module_open(const char *filename, void **out_handle, aos_app_t *out_app)
{
    char relative[160];
    snprintf(relative, sizeof(relative), "/%s/%s", AOS_DYNAPP_RELATIVE, filename);

    /* Size and date of the file: without this there is no way to know whether
     * the SD has the freshly compiled .so or an old one, and every subsequent
     * diagnosis is left hanging. It happens more often than it seems. */
    {
        char full[192];
        snprintf(full, sizeof(full), "%s%s", CONFIG_BSP_SD_MOUNT_POINT, relative);
        struct stat st;
        if (stat(full, &st) == 0) {
            struct tm tm_buf;
            char cuando[24] = "?";
            localtime_r(&st.st_mtime, &tm_buf);
            strftime(cuando, sizeof(cuando), "%Y-%m-%d %H:%M", &tm_buf);
            ESP_LOGI(TAG, "  %s: %u bytes, modificado %s",
                     filename, (unsigned)st.st_size, cuando);
        } else {
            ESP_LOGW(TAG, "  %s: could not read the size (%s)", filename, full);
        }
    }

    ESP_LOGI(TAG, "opening %s | executable: free %u B, largest block %u B | "
                  "internal: free %u B, largest block %u B",
             filename,
             (unsigned)heap_caps_get_free_size(MALLOC_CAP_EXEC),
             (unsigned)heap_caps_get_largest_free_block(MALLOC_CAP_EXEC),
             (unsigned)heap_caps_get_free_size(MALLOC_CAP_INTERNAL),
             (unsigned)heap_caps_get_largest_free_block(MALLOC_CAP_INTERNAL));

    void *handle = dlopen(relative, RTLD_NOW);
    if (!handle) {
        ESP_LOGE(TAG, "dlopen(%s) fallo: %s", relative, dlerror());
        /* The map of the executable heap: it distinguishes "there is no
         * memory" from "there is, but in pieces". With 54 KB free and the
         * largest hole at 36 KB, a 45 KB app does not fit even though the
         * total is there. */
        ESP_LOGW(TAG, "--- blocks of the executable heap ---");
        heap_caps_dump(MALLOC_CAP_EXEC);
        return false;
    }

    /* Espressif's loader only indexes symbols of function type, which is why
     * the entry point is two functions and not a structure (see aos_app.h). */
    uint32_t (*abi_fn)(void)            = dlsym(handle, "aos_app_abi");
    bool     (*init_fn)(aos_app_t *app) = dlsym(handle, "aos_app_init");

    if (!abi_fn || !init_fn) {
        ESP_LOGE(TAG, "%s does not export aos_app_abi/aos_app_init", filename);
        dlclose(handle);
        return false;
    }

    uint32_t abi = abi_fn();
    if (abi != AOS_ABI_VERSION) {
        ESP_LOGE(TAG, "%s uses ABI %u and the firmware expects %u: rebuild it",
                 filename, (unsigned)abi, (unsigned)AOS_ABI_VERSION);
        dlclose(handle);
        return false;
    }

    memset(out_app, 0, sizeof(*out_app));
    if (!init_fn(out_app)) {
        ESP_LOGE(TAG, "%s failed to initialise", filename);
        dlclose(handle);
        return false;
    }

    *out_handle = handle;
    return true;
}


static void module_close(dynapp_t *app);

/* Second attempt when there is no executable memory.
 *
 * Two levels, and deliberately NEITHER evicts an active background app: if the
 * Recorder is recording, unloading it stops the recording without warning.
 * Failing with a message saying who is holding the memory is preferred.
 *
 *   1. Drain the pending closes. dyn_destroy() only marks; the real close
 *      happens on the next aos_dynapp_tick(). If the load is attempted before
 *      that tick, it fails with the memory one step away.
 *   2. Unload modules that were left loaded without being in use or being
 *      background ones. There should not be any; if one turns up, it is a bug
 *      and this papers over it -but leaves it noted in the log-. */
static bool liberar_ejecutable(const dynapp_t *excepto)
{
    bool libero = false;

    for (int i = 0; i < s_count; i++) {
        dynapp_t *a = &s_apps[i];
        if (!a->in_use || &s_apps[i] == excepto || !a->handle) {
            continue;
        }
        if (a->pending_close) {
            ESP_LOGW(TAG, "out of memory: closing %s early", a->file);
            a->pending_close = false;
            module_close(a);
            libero = true;
        }
    }
    return libero;
}

/* Who is holding memory, so we can tell the user. */
static const char *retenedor(void)
{
    for (int i = 0; i < s_count; i++) {
        if (s_apps[i].in_use && s_apps[i].handle) {
            return s_apps[i].name[0] ? s_apps[i].name : s_apps[i].file;
        }
    }
    return NULL;
}

static bool module_ensure_open(dynapp_t *app)
{
    if (app->handle) {
        app->pending_close = false;     /* it was reopened before being closed */
        return true;
    }
    if (module_open(app->file, &app->handle, &app->loaded)) {
        return true;
    }

    /* One retry, after recovering whatever can be recovered without breaking
     * anything. */
    if (liberar_ejecutable(app) &&
        module_open(app->file, &app->handle, &app->loaded)) {
        ESP_LOGI(TAG, "%s loaded on the second attempt", app->file);
        return true;
    }
    return false;
}

static void module_close(dynapp_t *app)
{
    if (!app->handle) {
        ESP_LOGW(TAG, "closing %s with no handle: was it already unloaded?", app->file);
        return;
    }
    dlclose(app->handle);
    app->handle = NULL;
    memset(&app->loaded, 0, sizeof(app->loaded));
    ESP_LOGI(TAG, "%s descargada (ejecutable libre: %u B)", app->file,
             (unsigned)heap_caps_get_free_size(MALLOC_CAP_EXEC));
}

/* --------------------------------------------------------------------------
 * Trampolines: what the UI runtime sees
 * -------------------------------------------------------------------------- */

static void *dyn_create(aos_app_t *self, lv_obj_t *root)
{
    dynapp_t *app = find_by_id(self->desc.id);
    if (!app || !module_ensure_open(app)) {
        /* Saying WHO is holding the memory: without that the user has no way
         * of knowing that closing another app solves it. */
        const char *quien = retenedor();
        char aviso[96];
        if (quien) {
            snprintf(aviso, sizeof(aviso),
                     "Sin memoria.\n%s sigue en segundo plano:\ncerrala para liberar",
                     quien);
        } else {
            snprintf(aviso, sizeof(aviso), "No se pudo cargar la app");
        }
        aos_ui_toast(aviso, 3000);
        return NULL;
    }
    return app->loaded.create ? app->loaded.create(self, root) : NULL;
}

static void dyn_destroy(aos_app_t *self, void *inst)
{
    dynapp_t *app = find_by_id(self->desc.id);
    if (!app) {
        ESP_LOGE(TAG, "destroy of '%s' but it is not in the table",
                 self->desc.id ? self->desc.id : "(no id)");
        return;
    }
    if (app->loaded.destroy) {
        app->loaded.destroy(self, inst);
    }
    /* The dlclose does NOT go here: the runtime deletes the LVGL objects after
     * this callback, and those objects may have callbacks living inside the
     * .so. It is closed on the next tick, with everything already deleted. */
    app->pending_close = true;
}

static void dyn_show(aos_app_t *self, void *inst)
{
    dynapp_t *app = find_by_id(self->desc.id);
    if (app && app->loaded.show) {
        app->loaded.show(self, inst);
    }
}

static void dyn_hide(aos_app_t *self, void *inst)
{
    dynapp_t *app = find_by_id(self->desc.id);
    if (app && app->loaded.hide) {
        app->loaded.hide(self, inst);
    }
}

static bool dyn_back(aos_app_t *self, void *inst)
{
    dynapp_t *app = find_by_id(self->desc.id);
    return (app && app->loaded.back) ? app->loaded.back(self, inst) : false;
}

static bool dyn_button(aos_app_t *self, void *inst, int action)
{
    dynapp_t *app = find_by_id(self->desc.id);
    return (app && app->loaded.button) ? app->loaded.button(self, inst, action) : false;
}

static void dyn_tick(aos_app_t *self, void *inst)
{
    dynapp_t *app = find_by_id(self->desc.id);
    if (app && app->loaded.tick) {
        app->loaded.tick(self, inst);
    }
}

/* -------------------------------------------------------------------------- */

static bool register_stub(const char *filename)
{
    if (s_count >= MAX_DYNAPPS) {
        ESP_LOGE(TAG, "%s does not fit: the limit is %d dynamic apps and there are "
                      "already %d. Raise MAX_DYNAPPS or take a .so off the card",
                 filename, MAX_DYNAPPS, s_count);
        return false;
    }

    void *handle = NULL;
    aos_app_t probe;
    if (!module_open(filename, &handle, &probe)) {
        return false;
    }

    dynapp_t *slot = &s_apps[s_count];
    memset(slot, 0, sizeof(*slot));
    snprintf(slot->file, sizeof(slot->file), "%s", filename);
    snprintf(slot->id,   sizeof(slot->id),   "%s", probe.desc.id   ? probe.desc.id   : filename);
    snprintf(slot->name, sizeof(slot->name), "%s", probe.desc.name ? probe.desc.name : filename);
    snprintf(slot->icon, sizeof(slot->icon), "%s", probe.desc.icon ? probe.desc.icon : "");

    aos_app_t stub = {0};
    stub.desc = probe.desc;
    stub.desc.id   = slot->id;      /* pointing at OUR copies */
    stub.desc.name = slot->name;
    stub.desc.icon = slot->icon[0] ? slot->icon : NULL;

    stub.create  = dyn_create;
    stub.destroy = dyn_destroy;
    stub.show    = dyn_show;
    stub.hide    = dyn_hide;
    stub.back    = dyn_back;
    stub.button  = dyn_button;
    stub.tick    = dyn_tick;

    /* descriptor read, the code goes away: it comes back in when it is opened */
    dlclose(handle);

    slot->in_use = true;
    s_count++;

    bool ok = false;
    if (aos_hal_lock(1000)) {
        ok = aos_ui_register_app(&stub);
        aos_hal_unlock();
    }
    if (!ok) {
        slot->in_use = false;
        s_count--;
        return false;
    }

    ESP_LOGI(TAG, "registrada %s -> %s (%s)", filename, slot->id, slot->name);
    return true;
}

bool aos_dynapp_load(const char *filename)
{
    return filename ? register_stub(filename) : false;
}

bool aos_dynapp_unload(const char *app_id)
{
    dynapp_t *app = find_by_id(app_id);
    if (!app) {
        return false;
    }

    bool ok = false;
    if (aos_hal_lock(1000)) {
        ok = aos_ui_unregister_app(app_id);
        aos_hal_unlock();
    }
    if (ok) {
        module_close(app);
        app->in_use = false;
    }
    return ok;
}


/* Which modules are still loaded and how much executable memory they hold.
 *
 * An app with AOS_APP_FLAG_BACKGROUND is not destroyed on exit, so its .so
 * stays loaded until a restart. That is deliberate (the recorder has to go on
 * recording) but it is paid for in executable memory, which is where the code
 * of ALL dynamic apps comes from. Without this list there is no way to know
 * who is holding it. */
int aos_dynapp_loaded_list(char *out, size_t len)
{
    int n = 0;
    size_t used = 0;
    if (out && len) {
        out[0] = 0;
    }
    for (int i = 0; i < s_count; i++) {
        if (!s_apps[i].in_use || !s_apps[i].handle) {
            continue;
        }
        n++;
        if (out && used + 2 < len) {
            used += (size_t)snprintf(out + used, len - used, "%s%s",
                                     used ? " " : "", s_apps[i].file);
        }
    }
    return n;
}

void aos_dynapp_tick(void)
{
    for (int i = 0; i < s_count; i++) {
        if (s_apps[i].in_use && s_apps[i].pending_close) {
            s_apps[i].pending_close = false;
            module_close(&s_apps[i]);
        }
    }
}

static bool ends_with_so(const char *name)
{
    size_t len = strlen(name);
    return len > 3 && strcmp(name + len - 3, ".so") == 0;
}

int aos_dynapp_scan(void)
{
    /* Before anything else: the reservation is asked for with the heap still
     * whole. The scan opens and closes each .so, and afterwards WiFi starts,
     * which takes some 35 KB of this same memory. Asking for it later would be
     * asking for it already fragmented, which is precisely what we want to
     * avoid. */
    pool_init();

    elf_set_symbol_resolver(resolver);

    ESP_LOGI(TAG, "memoria ejecutable: %u B libres, mayor bloque %u B",
             (unsigned)heap_caps_get_free_size(MALLOC_CAP_EXEC),
             (unsigned)heap_caps_get_largest_free_block(MALLOC_CAP_EXEC));

    DIR *dir = opendir(AOS_DYNAPP_DIR);
    if (!dir) {
        ESP_LOGI(TAG, "there is no %s folder, no dynamic apps", AOS_DYNAPP_DIR);
        return 0;
    }

    int loaded = 0;
    struct dirent *item;
    while ((item = readdir(dir)) != NULL) {
        if (item->d_name[0] == '.' || !ends_with_so(item->d_name)) {
            continue;
        }
        if (register_stub(item->d_name)) {
            loaded++;
        }
    }
    closedir(dir);
    return loaded;
}
